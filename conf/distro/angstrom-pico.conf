## conf/distro/angstrom.conf
```bitbake
#@--------------------------------------------------------------------
#@TYPE: Distribution
#@NAME: Angstrom <http://github.com/angstrom-distribution>
#@DESCRIPTION: A flexible Linux Distribution
#@MAINTAINER: Koen Kooi <koen@dominion.thruhere.net>
#@--------------------------------------------------------------------

require conf/distro/include/arm-defaults.inc

# Preserve original DISTRO value
USERDISTRO := "${DISTRO}"
DISTRO = "angstrom"
DISTRO_NAME = "Angstrom"

BUILDNAME = "Angstrom ${DISTRO_VERSION}"

TARGET_VENDOR = "-angstrom"
SDK_VENDOR = "-angstromsdk"

DISTRO_VERSION = "v2025.06"

TCMODE ?= "default"

# Define a default set of features
DISTRO_FEATURES:append = " alsa bluetooth wifi"
DISTRO_FEATURES:append = " efi largefile pam pni-names"
DISTRO_FEATURES:append = " systemd zeroconf"
DISTRO_FEATURES:append = " opencl opengl vulkan wayland x11 glvnd"
DISTRO_FEATURES:append = " polkit"

FORTRAN:forcevariable = ",fortran"

# The only sane way :)
INIT_MANAGER = "systemd"
VIRTUAL-RUNTIME_init_manager = "systemd"
VIRTUAL-RUNTIME_dev_manager  = "udev"

# Set a default for EFI bootloaders
EFI_PROVIDER = "systemd-boot"

# Unlock multimedia
LICENSE_FLAGS_ACCEPTED += "commercial"

# Disable uninative
INHERIT:remove = "uninative"

#Name the generated images in a sane way
IMAGE_NAME = "${DISTRO_NAME}-${IMAGE_BASENAME}-${DISTRO_VERSION}-${MACHINE}"

# Put `deploy` front and center
DEPLOY_DIR = "${TOPDIR}/deploy"
DEPLOY_DIR_IMAGE = "${DEPLOY_DIR}/images/${MACHINE}"
IMAGE_FSTYPES:append = " tar.gz"
IMAGE_FSTYPES:remove = " tar.xz"

# Undo damage from external layers
TI_COMMON_DEPLOY = "${DEPLOY_DIR}"
DEPLOY_DIR_IMAGE:ti-soc = "${DEPLOY_DIR}/images/${MACHINE}"

# Angstrom *always* has some form of release config, so error out if someone thinks he knows better 
DISTRO_CHECK := "${@d.getVar("DISTRO_VERSION",1) or bb.fatal('Remove this line or set a dummy DISTRO_VERSION if you really want to build an unversioned distro')}"

# Prefer pigz, it's much, much faster on multi-core systems
PREFERRED_PROVIDER_gzip-native = "pigz-native"

# /etc/version is redundant with /etc/os-release; drop it.
INHERIT += "angstrom-remove-etc-version"


#Use this variable in feeds and other parts that need a URI
ANGSTROM_URI ?= "http://feeds.angstrom-distribution.org"

TCLIBC = "glibc"
ANGSTROM_PKG_FORMAT = "ipk"
PACKAGE_CLASSES = "package_${ANGSTROM_PKG_FORMAT}"


FEED_ARCH ?= "${TUNE_PKGARCH}"
TUNE_ARMPKGARCH = "${ARMPKGARCH}${ARMPKGSFX_DSP}${ARMPKGSFX_EABI}${ARMPKGSFX_ENDIAN}${ARMPKGSFX_FPU}"
FEED_ARCHS ?= "${TUNE_PKGARCH} ${TUNE_ARMPKGARCH}"

# set feed path variables
FEED_BASEPATH = "feeds/${DISTRO_VERSION}/${ANGSTROM_PKG_FORMAT}/${TCLIBC}/"
```
