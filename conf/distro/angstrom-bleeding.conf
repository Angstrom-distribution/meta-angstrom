## conf/distro/angstrom-v2012.x.conf
```bitbake
#@--------------------------------------------------------------------
#@TYPE: Distribution
#@NAME: Angstrom <http://www.angstrom-distribution.org>
#@DESCRIPTION: The Linux Distribution for Kernel 2.6 based devices
#@MAINTAINER: Graeme 'XorA' Gregory <dp@xora.org.uk>
#@MAINTAINER: Koen Kooi <koen@openembedded.org>
#@MAINTAINER: Philip 'Crofton' Balister <philip@balister.org>
#@--------------------------------------------------------------------

# This is a aimed to be the next stable angstrom release. 
# If you want something stable *right now*, use angstrom-v2012.05
#
# Use this at your own risk, we welcome bugreports sent to
#    angstrom-distro-devel@linuxtogo.org
#
# For more contact info please visit
#    http://www.angstrom-distribution.org/contact
#
# Again, in doubt, use the master branch of setup-scripts

#DISTRO_VERSION = "v2012.X"
DISTRO_VERSION = "v${@time.strftime('%Y.%m',time.gmtime())}-core"
DISTRO_REVISION = "5"
DISTRO_PR = ".11"

OLDEST_KERNEL = "2.6.16"

require conf/distro/include/sane-srcdates.inc
require conf/distro/include/sane-srcrevs.inc
require conf/distro/include/angstrom-2010-preferred-versions.inc

#Images built can have to modes:
# 'debug': empty rootpassword, strace included
# 'release' no root password, no strace and gdb by default
DISTRO_TYPE ?= "debug"
#DISTRO_TYPE = "release"

# Set the toolchain type (internal, external) and brand (generic, csl etc.)
TOOLCHAIN_TYPE ?= "internal"
TOOLCHAIN_BRAND ?= ""

# Ship just basic locale by default. Locales are big (~1Mb uncompr.), so
# shipping some adhoc subset will be still useless and size burden for
# users of all other languages/countries. Instead, worth to make it easy
# to install additional languages: installer/wizard + metapackages which
# will RRECOMMEND as much as possible content for a given language
# (locales, UI transalations, help, etc. - useless for pros, but really 
# helpful for common users).
# Also, it appears that no locales fit in 16Mb for now. "C" locale rules!
IMAGE_LINGUAS ?= '${@base_less_or_equal("ROOT_FLASH_SIZE", "16", "", "en-us", d)}'

# set feed path variables
FEED_BASEPATH = "feeds/core/${ANGSTROM_PKG_FORMAT}/${TCLIBC}/"

#This is unrelated to the kernel version, but userspace apps (e.g. udev/systemd) require a recent version to build against
LINUX_LIBC_HEADERS_VERSION ?= "3.2"
PREFERRED_VERSION_linux-libc-headers = "${LINUX_LIBC_HEADERS_VERSION}"
PREFERRED_VERSION_linux-libc-headers-native = "${LINUX_LIBC_HEADERS_VERSION}"
PREFERRED_VERSION_linux-libc-headers-nativesdk = "${LINUX_LIBC_HEADERS_VERSION}"


ANGSTROM_EGLIBC_VERSION                 ?= "2.15"
ANGSTROM_GLIBC_VERSION                  ?= "2.10.1"
ANGSTROM_UCLIBC_VERSION                 ?= "0.9.32"

#Prefer glibc 2.6 and uclibc 0.9.30, these have had the most testing.
PREFERRED_VERSION_glibc 		?= "${ANGSTROM_GLIBC_VERSION}"
PREFERRED_VERSION_glibc-initial 	?= "${ANGSTROM_GLIBC_VERSION}"
PREFERRED_VERSION_glibc-nativesdk 	?= "${ANGSTROM_GLIBC_VERSION}"
PREFERRED_VERSION_glibc-initial-nativesdk = "${ANGSTROM_GLIBC_VERSION}"

PREFERRED_VERSION_uclibc        	?= "${ANGSTROM_UCLIBC_VERSION}"
PREFERRED_VERSION_uclibc-initial	?= "${ANGSTROM_UCLIBC_VERSION}"
PREFERRED_VERSION_uclibc-nativesdk     	?= "${ANGSTROM_UCLIBC_VERSION}"
PREFERRED_VERSION_uclibc-initial-nativesdk ?= "${ANGSTROM_UCLIBC_VERSION}"

PREFERRED_VERSION_eglibc		?= "${ANGSTROM_EGLIBC_VERSION}"
PREFERRED_VERSION_eglibc-initial	?= "${ANGSTROM_EGLIBC_VERSION}"
PREFERRED_VERSION_eglibc-nativesdk	?= "${ANGSTROM_EGLIBC_VERSION}"
PREFERRED_VERSION_eglibc-initial-nativesdk ?= "${ANGSTROM_EGLIBC_VERSION}"
PREFERRED_VERSION_eglibc-locale		?= "${ANGSTROM_EGLIBC_VERSION}"
PREFERRED_VERSION_cross-localedef-native ?= "${ANGSTROM_EGLIBC_VERSION}"

# Blackfin has its on gcc
ANGSTROM_GCC_VERSION_bfin			= "4.1.2"

#avr32 only has support for gcc 4.2.2
ANGSTROM_GCC_VERSION_avr32		         ?= "4.2.2"

#Everybody else can just use this: 
ANGSTROM_GCC_VERSION                             ?= "4.7"

ANGSTROM_BINUTILS_VERSION                        ?= "2.22"

PREFERRED_VERSION_binutils                       ?= "${ANGSTROM_BINUTILS_VERSION}"
PREFERRED_VERSION_binutils-cross                 ?= "${ANGSTROM_BINUTILS_VERSION}"
PREFERRED_VERSION_binutils-crosssdk              ?= "${ANGSTROM_BINUTILS_VERSION}"
PREFERRED_VERSION_binutils-cross-canadian-${TRANSLATED_TARGET_ARCH} ?= "${ANGSTROM_BINUTILS_VERSION}"
PREFERRED_VERSION_gcc-cross-canadian-${TRANSLATED_TARGET_ARCH} ?= "${ANGSTROM_GCC_VERSION}"

PREFERRED_VERSION_gcc                            ?= "${ANGSTROM_GCC_VERSION}"
PREFERRED_VERSION_gcc-cross                      ?= "${ANGSTROM_GCC_VERSION}"
PREFERRED_VERSION_gcc-cross-initial              ?= "${ANGSTROM_GCC_VERSION}"
PREFERRED_VERSION_gcc-cross-intermediate         ?= "${ANGSTROM_GCC_VERSION}"
PREFERRED_VERSION_gcc-cross-canadian             ?= "${ANGSTROM_GCC_VERSION}"
PREFERRED_VERSION_gcc-crosssdk                   ?= "${ANGSTROM_GCC_VERSION}"
PREFERRED_VERSION_gcc-crosssdk-initial           ?= "${ANGSTROM_GCC_VERSION}"
PREFERRED_VERSION_gcc-crosssdk-intermediate      ?= "${ANGSTROM_GCC_VERSION}"
PREFERRED_VERSION_gcc-runtime                    ?= "${ANGSTROM_GCC_VERSION}"
PREFERRED_VERSION_gcc-runtime-nativesdk          ?= "${ANGSTROM_GCC_VERSION}"
PREFERRED_VERSION_libgcc                         ?= "${ANGSTROM_GCC_VERSION}"
PREFERRED_VERSION_libgcc-nativesdk               ?= "${ANGSTROM_GCC_VERSION}"

#avr32 only has patches for binutils 2.17 in OE
PREFERRED_VERSION_binutils_avr32 = "2.17"
PREFERRED_VERSION_binutils-cross_avr32 = "2.17"
PREFERRED_VERSION_binutils-cross-sdk_avr32 = "2.17"

PREFERRED_PROVIDER_dbus-glib             = "dbus-glib"
PREFERRED_PROVIDER-gconf-dbus            = "gconf"
PREFERRED_PROVIDER_hotplug               = "udev"
PREFERRED_PROVIDER_opkg                 ?= "opkg"
PREFERRED_PROVIDER_opkg-native          ?= "opkg-native"

ANGSTROM_BLACKLIST_pn-fso-apm       = "regular apmd is good enough"

ANGSTROM_BLACKLIST_pn-gconf-dbus	= "gconf-dbus has been merged back into main GConf"
ANGSTROM_BLACKLIST_pn-gconf-dbus-native	= "gconf-dbus has been merged back into main GConf"

require conf/distro/include/angstrom.inc

# Toolchain virtuals:
require conf/distro/include/toolchain-${TOOLCHAIN_TYPE}.inc

# Set DISTRO_FEED_CONFIGS to our config var, assigned in the above .inc
DISTRO_FEED_CONFIGS = "${ANGSTROM_FEED_CONFIGS}"

# If we're using an .ipk based rootfs, we want to have opkg installed so postinst script can run
# We also take this opportunity to inject angstrom-version and the feed configs into the rootfs
IPKG_VARIANT = "opkg angstrom-version ${ANGSTROM_FEED_CONFIGS}"

# Select xserver-xorg as default, since kdrive has been EOL'ed
XSERVER ?= "xserver-xorg xf86-input-evdev xf86-input-keyboard xf86-input-mouse xf86-video-fbdev" 

# do some task-base stuff here

# Prefer bluez4, it's needed for things like connman. Bluez4 is also largely backward compatible with
# bluez 3.x
DISTRO_BLUETOOTH_MANAGER = "\
	blueprobe \
	bluez4 \
   "

# We want to ship extra debug utils in the rootfs when doing a debug build 
DEBUG_APPS ?= ""
DEBUG_APPS += '${@base_conditional("DISTRO_TYPE", "release", "", "strace procps",d)}'

# This hooks into task-base, so it won't do anything if your images doesn't include task-base.
# angstrom-version: ship this to have an identifiable rootfs so user can report bugs against a specific version
# ANGSTROM_FEED_CONFIGS: configfiles for the online feeds
# util-linux-mount util-linux-umount: busybox mount is broken
# angstrom-libc-fixup-hack: fixes an obscure bug with libc.so symlink
DISTRO_EXTRA_RDEPENDS += "\
    angstrom-version \
    ${ANGSTROM_FEED_CONFIGS} \
    util-linux-mount util-linux-umount \
    angstrom-libc-fixup-hack \
    "

# This also hooks into task-base, but isn't mandatory.
# If you don't want parts of this in your task-base using images you can put this in the image recipe:
# BAD_RECOMMENDATIONS = "avahi-daemon avahi-autoipd"
# Note that BAD_RECOMMENDATIONS is a feature of rootfs_ipk.bbclass, not angstrom
# kernel modules: ship fs modules so you can mount stuff and af-packet so networking works
# avahi: makes finding your device on the network a lot easier
# openssh-sftp-server: provides sftp which combined with avahi makes it real easy to use things like sshfs
# psplash-angstrom: angstrom branded psplash, you can add your own psplash-foo to an image, it uses update-alternatives
# DEBUG_APPS: ship strace and procpc to make simple debugging a lot easier
DISTRO_EXTRA_RRECOMMENDS += " \
    kernel-module-vfat \
    kernel-module-ext2 \
    kernel-module-ext3 \
    kernel-module-af-packet \
    avahi-daemon \
    avahi-autoipd \
    openssh-sftp-server \
    ${DEBUG_APPS} \
"

SPLASH ?= ' ${@base_contains("MACHINE_FEATURES", "screen", "psplash-angstrom", "",d)}'

DISTRO_FEATURES += "${LDISGOLD}"
LDISGOLD_arm = "ld-is-gold"
LDISGOLD_x86 = "ld-is-gold"
LDISGOLD_x86_64 = "ld-is-gold"
LDISGOLD = ""
```

## conf/distro/include/angstrom-2010-preferred-versions.inc
```bitbake
ANGSTROM_MESA_VERSION = "7.11"
ANGSTROM_QT_VERSION ?= "4.8.0"

PREFERRED_VERSION_gobject-introspection-native = "0.9.10"
PREFERRED_VERSION_mesa          = "${ANGSTROM_MESA_VERSION}"
PREFERRED_VERSION_mesa-dri      = "${ANGSTROM_MESA_VERSION}"
PREFERRED_VERSION_mesa-xlib     = "${ANGSTROM_MESA_VERSION}"
PREFERRED_VERSION_qt4-native = "${ANGSTROM_QT_VERSION}"
PREFERRED_VERSION_qt4-tools-native = "${ANGSTROM_QT_VERSION}"
PREFERRED_VERSION_qt4-tools-nativesdk = "${ANGSTROM_QT_VERSION}"
PREFERRED_VERSION_qt4-tools-sdk = "${ANGSTROM_QT_VERSION}"
PREFERRED_VERSION_qt4-embedded = "${ANGSTROM_QT_VERSION}"
PREFERRED_VERSION_qt4-embedded-gles = "${ANGSTROM_QT_VERSION}"
PREFERRED_VERSION_qt4-x11-free = "${ANGSTROM_QT_VERSION}"
PREFERRED_VERSION_qt4-x11-free-gles = "${ANGSTROM_QT_VERSION}"
PREFERRED_VERSION_udev = "182"

UDEV_GE_141 = "1"
```

## conf/distro/include/angstrom-core-tweaks.inc
```bitbake
# This include is to import changes from OE that are hard to overlay into core

# Default hash policy for distro
BB_SIGNATURE_HANDLER ?= "OEBasicHash"

# The network based PR service host and port
# Uncomment the following lines to enable PRservice.
# Set PRSERV_HOST to 'localhost' and PRSERV_PORT to '0' to automatically
# start local PRService.
# Set to other values to use remote PRService.
#PRSERV_HOST ?= "localhost"
#PRSERV_PORT ?= "0"
 

# Empty commercial license, we want to build a superset for the default config
COMMERCIAL_LICENSE = ""
LICENSE_FLAGS_WHITELIST += "commercial"

ACCEPT_QCOM_EULA = "1"

ACCEPT_EULA_dragonboard-410c-32 = "1"
ACCEPT_EULA_dragonboard-410c = "1"
ACCEPT_EULA_dragonboard-820c = "1"
ACCEPT_EULA_ifc6410 = "1"
ACCEPT_EULA_sd-600eval = "1"


# Unbreak multimachine builds
LICENSE_DIRECTORY = "${DEPLOY_DIR}/licenses/${MACHINE_ARCH}"

# Preset set this or bbappends break
PRINC ??= "0"

# Shared state fixups
MACHINEOVERRIDES[vardepsexclude] += "SOC_FAMILY"

# Tuning and package arch compatibility

# Turn armv7a-vfp-neon into armv7a for compatibility reasons
# In the long term the switch to the longer arch needs to be made,
# but that needs a coordinated effort
#PKGARCHCOMPAT_ARMV7A = "True"

# Providers

# opkg
PREFERRED_PROVIDER_opkg-collateral = "angstrom-feed-configs"
EXTRA_IMAGE_FEATURES ?= "package-management empty-root-password"

PREFERRED_PROVIDER_os-release = "angstrom-version"

# Prefer libjpeg-turbo
PREFERRED_PROVIDER_jpeg = "libjpeg-turbo"
PREFERRED_PROVIDER_jpeg-native = "libjpeg-turbo-native"

# Prefer the one from meta-oe over the one in oe-core
PREFERRED_PROVIDER_virtual/libx11 = "libx11"
PREFERRED_PROVIDER_virtual/xserver-xf86 = "xserver-xorg"
PREFERRED_PROVIDER_virtual/xserver = "xserver-xorg"

# bitbake.conf stuff:

TOOLCHAIN_PATH ?= "${STAGING_DIR_NATIVE}${prefix_native}/bin/${TUNE_PKGARCH}${HOST_VENDOR}-${HOST_OS}"
TOOLCHAIN_SYSPATH ?= "${TOOLCHAIN_PATH}/${TARGET_SYS}"

# Package manager selection, angstrom uses ANGSTROM_PKG_FORMAT

PACKAGE_CLASSES = "package_ipk"

# Image.bbclass stuff:

# Override default fs-perms.txt that messes with our /var setup:
FILESYSTEM_PERMS_TABLES = "fs-perms-angstrom.txt"
 
#
# udev, devfsd, busybox-mdev (from busybox) or none
#
IMAGE_DEV_MANAGER ?= "udev"
#
# sysvinit, upstart, systemd
#
IMAGE_INIT_MANAGER ?= "systemd"
IMAGE_INITSCRIPTS ?= "systemd-compat-units"
#
# busybox, getty
#
IMAGE_LOGIN_MANAGER ?= "busybox"

# set sane default for the SPLASH variable
SPLASH ?= ""

IMAGE_KEEPROOTFS ?= ""
IMAGE_KEEPROOTFS[doc] = "Set to non-empty to keep ${IMAGE_ROOTFS} around after image creation."

IMAGE_BOOT ?= "${IMAGE_INITSCRIPTS} \
               ${IMAGE_DEV_MANAGER} \
               ${IMAGE_INIT_MANAGER} \
               ${IMAGE_LOGIN_MANAGER}"

# some default locales
IMAGE_LINGUAS ?= "de-de fr-fr en-gb"

IMAGE_INSTALL += "${IMAGE_BOOT}"

# Layer tweaks

# meta-opie
include conf/distro/include/preferred-opie-git-versions.inc 
PREFERRED_PROVIDER_virtual/libsdl = "libsdl"

# SDK stuff

PREFERRED_PROVIDER_libltdl-dev = "libtool"
PREFERRED_PROVIDER_libtool = "libtool"

SDK_NAME = "${DISTRO}-${TCLIBC}-${SDK_ARCH}-${FEED_ARCH}"
TOOLCHAIN_OUTPUTNAME ?= "${SDK_NAME}-${DISTRO_VERSION}-toolchain"

FREESMARTPHONE_GIT = "git://git.freesmartphone.org"
E_MIRROR = "http://download.enlightenment.org/releases"
FREEBSD_MIRROR = "ftp://ftp.freebsd.org/pub/FreeBSD/"
E_SVN = "svn://svn.enlightenment.org/svn/e"
```

## conf/distro/include/angstrom-eglibc.inc
```bitbake
# eglibc:
PNBLACKLIST[libiconv] = "the eglibc provided iconv library is used"

TARGET_OS = "linux"

# sane-toolchain.inc has this, and explains the GNU and ABI suffices:
#TARGET_OS = "${@compute_os_portion_of_target_triplet(d)}"

TARGET_OS .= "${@['','-gnueabi'][bb.data.getVar('TARGET_ARCH',d,1) in ['arm', 'armeb']]}"
TARGET_OS .= "${@['','-gnuspe'][bb.data.getVar('TUNE_PKGARCH',d,1) in ['ppce500', 'ppce500v2']]}"

# perl has some problems, see http://bugs.openembedded.net/show_bug.cgi?id=1616
# [23:00] oxo: glibc (any version) on sparc does not like (repeat me) "-Os"

FULL_OPTIMIZATION_pn-perl = "-O1 -g"

TARGET_LINK_HASH_STYLE = "${@['-Wl,--hash-style=gnu',''][bb.data.getVar('TARGET_ARCH',d,1) in ['mips', 'mipsel', 'mips64', 'mips64el']]}"
```

## conf/distro/include/angstrom-glibc.inc
```bitbake
# glibc:
PNBLACKLIST[libiconv] = "the glibc provided iconv library is used"

TARGET_OS = "linux"

# sane-toolchain.inc has this, and explains the GNU and ABI suffices:
#TARGET_OS = "${@compute_os_portion_of_target_triplet(d)}"

TARGET_OS .= "${@['','-gnueabi'][d.getVar('TARGET_ARCH',1) in ['arm', 'armeb']]}"
TARGET_OS .= "${@['','-gnuspe'][d.getVar('TUNE_PKGARCH',1) in ['ppce500', 'ppce500v2']]}"

# perl has some problems, see http://bugs.openembedded.net/show_bug.cgi?id=1616
# [23:00] oxo: glibc (any version) on sparc does not like (repeat me) "-Os"

TARGET_LINK_HASH_STYLE = "${@['-Wl,--hash-style=gnu',''][d.getVar('TARGET_ARCH',1) in ['mips', 'mipsel', 'mips64', 'mips64el']]}"

# We use gold as default linker for arm/x86 on eglibc based images
DISTRO_FEATURES_append_arm = " ld-is-gold"
DISTRO_FEATURES_append_x86 = " ld-is-gold"
DISTRO_FEATURES_append_x86-64 = " ld-is-gold"
```
